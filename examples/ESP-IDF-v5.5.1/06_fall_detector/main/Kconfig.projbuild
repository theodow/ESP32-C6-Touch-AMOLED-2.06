## examples/ESP-IDF-v5.5.1/06_fall_detector/main/Kconfig.projbuild
```kconfig
menu "Fall detector"

    config FALL_SAMPLE_RATE_HZ
        int "IMU sampling rate (Hz)"
        range 10 200
        default 50
        help
            Rate at which accelerometer and gyroscope samples are pushed into
            the sliding window. A TFLite model must be trained at the same rate.

    config FALL_WINDOW_SAMPLES
        int "Sliding window length (samples)"
        range 32 512
        default 128
        help
            Number of 6-axis samples the detector looks at in one evaluation.
            128 samples at 50 Hz is 2.56 s.

    config FALL_STRIDE_SAMPLES
        int "Evaluation stride (samples)"
        range 1 512
        default 25
        help
            The window is evaluated every this many new samples once it is full.

    config FALL_REFRACTORY_MS
        int "Refractory time after an alert (ms)"
        default 5000
        help
            Further detections are suppressed for this long after an alert, so a
            single fall raises a single alert.

    choice FALL_BACKEND
        prompt "Detection backend"
        default FALL_BACKEND_HEURISTIC

        config FALL_BACKEND_HEURISTIC
            bool "Threshold heuristic (free fall, impact, stillness)"

        config FALL_BACKEND_TFLM
            bool "TensorFlow Lite Micro model"
            help
                Requires main/model/fall_model_data.cc and fall_model_config.h,
                generated by training/train_fall_model.py.
    endchoice

    menu "Heuristic thresholds"
        depends on FALL_BACKEND_HEURISTIC

        config FALL_IMPACT_MG
            int "Impact threshold (mg)"
            default 2500
            help
                Peak acceleration magnitude that counts as an impact.

        config FALL_FREEFALL_REQUIRED
            bool "Require a free-fall phase before the impact"
            default y

        config FALL_FREEFALL_MG
            int "Free-fall threshold (mg)"
            depends on FALL_FREEFALL_REQUIRED
            default 600
            help
                The acceleration magnitude must drop below this in the 0.5 s
                before the impact.

        config FALL_POST_IMPACT_MS
            int "Minimum observed time after the impact (ms)"
            default 1000
            help
                The impact is only judged once at least this much data after it
                is in the window. The first 0.5 s after the impact is ignored
                when checking for stillness.

        config FALL_STILL_STD_MG
            int "Post-impact stillness threshold (mg, standard deviation)"
            default 150
    endmenu

    menu "TFLite Micro"
        depends on FALL_BACKEND_TFLM

        config FALL_TFLM_THRESHOLD_PCT
            int "Fall probability threshold (%)"
            range 1 99
            default 70

        config FALL_TFLM_ARENA_KB
            int "Tensor arena size (KB)"
            default 24
    endmenu

    config FALL_LOG_SAMPLES
        bool "Print every IMU sample as CSV on the console"
        default n
        help
            Prints lines "IMU,<ms>,ax,ay,az,gx,gy,gz" (g and deg/s) for recording
            training data. training/train_fall_model.py reads these logs.

endmenu
```
